## configs/boards/ADP-226.conf
```kconfig
# ================================
# ADP-226 Board Configuration File
# ================================
CONFIG_BOARD_NAME="ADP-226"

# ==================================
# ===== Watchdog Configuration =====
# ==================================
MAKE_WDT_DEVICE=ec
MAKE_WDT_CHIPSET=
CONFIG_WDT_CHIPSET=


# ==========================================
# ===== Hardware Monitor Configuration =====
# ==========================================
MAKE_HWM_DEVICE=ec
MAKE_HWM_CHIPSET=
CONFIG_HWM_CHIPSET=

# ===== Hardware Monitor Voltage Configuration =====
# Unsupported yet.

CONFIG_HWM_VOLTAGE_0_ENABLE=0
CONFIG_HWM_VOLTAGE_1_ENABLE=0
CONFIG_HWM_VOLTAGE_2_ENABLE=0
CONFIG_HWM_VOLTAGE_3_ENABLE=0
CONFIG_HWM_VOLTAGE_4_ENABLE=0
CONFIG_HWM_VOLTAGE_5_ENABLE=0
CONFIG_HWM_VOLTAGE_6_ENABLE=0
CONFIG_HWM_VOLTAGE_7_ENABLE=0

CONFIG_HWM_VOLTAGE_NUM=8
CONFIG_HWM_VOLTAGE_MAP={ CONFIG_HWM_VOLTAGE_0_ENABLE, CONFIG_HWM_VOLTAGE_1_ENABLE, CONFIG_HWM_VOLTAGE_2_ENABLE, CONFIG_HWM_VOLTAGE_3_ENABLE, CONFIG_HWM_VOLTAGE_4_ENABLE, CONFIG_HWM_VOLTAGE_5_ENABLE, CONFIG_HWM_VOLTAGE_6_ENABLE, CONFIG_HWM_VOLTAGE_7_ENABLE }


# ===== Hardware Monitor Temperature Configuration =====
# Unsupported yet.

CONFIG_HWM_TEMPERATURE_0_ENABLE=0
CONFIG_HWM_TEMPERATURE_1_ENABLE=0
CONFIG_HWM_TEMPERATURE_2_ENABLE=0

CONFIG_HWM_TEMPERATURE_NUM=3
CONFIG_HWM_TEMPERATURE_MAP={ CONFIG_HWM_TEMPERATURE_0_ENABLE, CONFIG_HWM_TEMPERATURE_1_ENABLE, CONFIG_HWM_TEMPERATURE_2_ENABLE }


# ===== Hardware Monitor Fan Configuration =====
# Unsupported yet.

CONFIG_HWM_FAN_0_ENABLE=0
CONFIG_HWM_FAN_1_ENABLE=0

CONFIG_HWM_FAN_NUM=2
CONFIG_HWM_FAN_MAP={ CONFIG_HWM_FAN_0_ENABLE, CONFIG_HWM_FAN_1_ENABLE }

# ==============================
# ===== GPIO Configuration =====
# ==============================
MAKE_GPIO_DEVICE=smb
MAKE_GPIO_PROTOCOL=i801

MAKE_GPIO_CHIPSET=nct5655

CONFIG_SMBUS_BASE_PORT=0x0000

CONFIG_SMBUS_SLAVE_ADDR1=0x40
CONFIG_SMBUS_SLAVE_ADDR2=0x40

CONFIG_GPIO_PIN0_OFFSET=0
CONFIG_GPIO_PIN1_OFFSET=1
CONFIG_GPIO_PIN2_OFFSET=2
CONFIG_GPIO_PIN3_OFFSET=3

CONFIG_GPIO_PIN4_OFFSET=8
CONFIG_GPIO_PIN5_OFFSET=9
CONFIG_GPIO_PIN6_OFFSET=10
CONFIG_GPIO_PIN7_OFFSET=11

CONFIG_GPIO_PIN_NUM=8
CONFIG_GPIO_PIN_MAP={ CONFIG_GPIO_PIN0_OFFSET, CONFIG_GPIO_PIN1_OFFSET, CONFIG_GPIO_PIN2_OFFSET, CONFIG_GPIO_PIN3_OFFSET, CONFIG_GPIO_PIN4_OFFSET, CONFIG_GPIO_PIN5_OFFSET, CONFIG_GPIO_PIN6_OFFSET, CONFIG_GPIO_PIN7_OFFSET }
```
