## configs/boards/MX610H.conf
```kconfig
# ================================
# MX610H Board Configuration File
# ================================
CONFIG_BOARD_NAME="MX610H"

# ==================================
# ===== Watchdog Configuration =====
# ==================================
MAKE_WDT_DEVICE=sio
MAKE_WDT_CHIPSET=f81966
CONFIG_WDT_CHIPSET=f81966
CONFIG_CHIPID=0x1502


# ==========================================
# ===== Hardware Monitor Configuration =====
# ==========================================
MAKE_HWM_DEVICE=sio
MAKE_HWM_CHIPSET=f81966
CONFIG_HWM_CHIPSET=f81966

# ===== Hardware Monitor Voltage Configuration =====
#define F81966_HWM_REG_VOL(x) (0x20 + (x))

# 0: 0x20 3VCC R1=20k, R2=10K, Step=8mV
CONFIG_HWM_VOLTAGE_0_ENABLE=1
CONFIG_HWM_VOLTAGE_0_REG=F81966_HWM_REG_VOL(0)
CONFIG_HWM_VOLTAGE_0_LABEL="3VCC"
CONFIG_HWM_VOLTAGE_0_LSB=8
CONFIG_HWM_VOLTAGE_0_R1=20000
CONFIG_HWM_VOLTAGE_0_R2=10000

# 1: 0x21 VCore Step=8mv
CONFIG_HWM_VOLTAGE_1_ENABLE=1
CONFIG_HWM_VOLTAGE_1_REG=F81966_HWM_REG_VOL(1)
CONFIG_HWM_VOLTAGE_1_LABEL="VCore"
CONFIG_HWM_VOLTAGE_1_LSB=8
CONFIG_HWM_VOLTAGE_1_R1=0
CONFIG_HWM_VOLTAGE_1_R2=0

# 2: 0x22 VIN2 5V R1=200k, R2=47k, Step=8mV
CONFIG_HWM_VOLTAGE_2_ENABLE=1
CONFIG_HWM_VOLTAGE_2_REG=F81966_HWM_REG_VOL(2)
CONFIG_HWM_VOLTAGE_2_LABEL="VCC5"
CONFIG_HWM_VOLTAGE_2_LSB=8
CONFIG_HWM_VOLTAGE_2_R1=200000
CONFIG_HWM_VOLTAGE_2_R2=47000

# 3: 0x23 VIN3 12V R1=200k, R2=20k, Step=8mV
CONFIG_HWM_VOLTAGE_3_ENABLE=1
CONFIG_HWM_VOLTAGE_3_REG=F81966_HWM_REG_VOL(3)
CONFIG_HWM_VOLTAGE_3_LABEL="VCC12"
CONFIG_HWM_VOLTAGE_3_LSB=8
CONFIG_HWM_VOLTAGE_3_R1=200000
CONFIG_HWM_VOLTAGE_3_R2=20000

# 4: 0x24 VIN4 Unused
CONFIG_HWM_VOLTAGE_4_ENABLE=0

# 5: 0x25 VSB3V Step=16mV
CONFIG_HWM_VOLTAGE_5_ENABLE=1
CONFIG_HWM_VOLTAGE_5_REG=F81966_HWM_REG_VOL(5)
CONFIG_HWM_VOLTAGE_5_LABEL="VSB3V"
CONFIG_HWM_VOLTAGE_5_LSB=16
CONFIG_HWM_VOLTAGE_5_R1=0
CONFIG_HWM_VOLTAGE_5_R2=0

# 6: 0x26 VBAT Step=16mv
CONFIG_HWM_VOLTAGE_6_ENABLE=1
CONFIG_HWM_VOLTAGE_6_REG=F81966_HWM_REG_VOL(6)
CONFIG_HWM_VOLTAGE_6_LABEL="VBAT"
CONFIG_HWM_VOLTAGE_6_LSB=16
CONFIG_HWM_VOLTAGE_6_R1=0
CONFIG_HWM_VOLTAGE_6_R2=0

# 7: 0x27 5VSB Step=3mv
CONFIG_HWM_VOLTAGE_7_ENABLE=1
CONFIG_HWM_VOLTAGE_7_REG=F81966_HWM_REG_VOL(7)
CONFIG_HWM_VOLTAGE_7_LABEL="5VSB"
CONFIG_HWM_VOLTAGE_7_LSB=3
CONFIG_HWM_VOLTAGE_7_R1=0
CONFIG_HWM_VOLTAGE_7_R2=0

# Fixed to 8 voltage sensors for F81966
CONFIG_HWM_VOLTAGE_NUM=8
CONFIG_HWM_VOLTAGE_MAP={ CONFIG_HWM_VOLTAGE_0_ENABLE, CONFIG_HWM_VOLTAGE_1_ENABLE, CONFIG_HWM_VOLTAGE_2_ENABLE, CONFIG_HWM_VOLTAGE_3_ENABLE, CONFIG_HWM_VOLTAGE_4_ENABLE, CONFIG_HWM_VOLTAGE_5_ENABLE, CONFIG_HWM_VOLTAGE_6_ENABLE, CONFIG_HWM_VOLTAGE_7_ENABLE }


# ===== Hardware Monitor Temperature Configuration =====
#define F81966_HWM_REG_TEMP(x) (0x70 + (2 * (x)))

# 0: 0x70 System Temperature 1
CONFIG_HWM_TEMPERATURE_0_ENABLE=1
CONFIG_HWM_TEMPERATURE_0_REG=F81966_HWM_REG_TEMP(1)
CONFIG_HWM_TEMPERATURE_0_LABEL="System Temp 1"

# 1: 0x72 System Temperature 2
CONFIG_HWM_TEMPERATURE_1_ENABLE=1
CONFIG_HWM_TEMPERATURE_1_REG=F81966_HWM_REG_TEMP(2)
CONFIG_HWM_TEMPERATURE_1_LABEL="System Temp 2"

# 2: 0x7E CPU Temperature
CONFIG_HWM_TEMPERATURE_2_ENABLE=1
CONFIG_HWM_TEMPERATURE_2_REG=F81966_HWM_REG_TEMP(7)
CONFIG_HWM_TEMPERATURE_2_LABEL="CPU Temp"

# Fixed to 3 temperature sensors for F81966
CONFIG_HWM_TEMPERATURE_NUM=3
CONFIG_HWM_TEMPERATURE_MAP={ CONFIG_HWM_TEMPERATURE_0_ENABLE, CONFIG_HWM_TEMPERATURE_1_ENABLE, CONFIG_HWM_TEMPERATURE_2_ENABLE }


# ===== Hardware Monitor Fan Configuration =====
#define F81966_HWM_REG_FAN_SPEED(x) (0xA0 + (16 * (x)))
#define F81966_HWM_REG_FAN_DUTY(x) (0xA2 + (16 * (x)))

# 0: 0xA0 Fan 1
CONFIG_HWM_FAN_0_ENABLE=1
CONFIG_HWM_FAN_0_REG_SPEED=F81966_HWM_REG_FAN_SPEED(0)
CONFIG_HWM_FAN_0_LABEL="CPU Fan"
CONFIG_HWM_FAN_0_SPEED_STEP=1500000

# 1: 0xB0 Fan 2
CONFIG_HWM_FAN_1_ENABLE=1
CONFIG_HWM_FAN_1_REG_SPEED=F81966_HWM_REG_FAN_SPEED(1)
CONFIG_HWM_FAN_1_LABEL="System Fan"
CONFIG_HWM_FAN_1_SPEED_STEP=1500000

# Fixed to 2 fan sensors for F81966
CONFIG_HWM_FAN_NUM=2
CONFIG_HWM_FAN_MAP={ CONFIG_HWM_FAN_0_ENABLE, CONFIG_HWM_FAN_1_ENABLE }


# ===== Hardware Monitor PWM Configuration =====

CONFIG_HWM_PWM_0_ENABLE=1
CONFIG_HWM_PWM_0_REG=F81966_HWM_REG_FAN_DUTY(0)
CONFIG_HWM_PWM_0_LABEL="CPU Fan PWM"

CONFIG_HWM_PWM_1_ENABLE=1
CONFIG_HWM_PWM_1_REG=F81966_HWM_REG_FAN_DUTY(1)
CONFIG_HWM_PWM_1_LABEL="System Fan PWM"

CONFIG_HWM_PWM_2_ENABLE=0
CONFIG_HWM_PWM_2_REG=0
CONFIG_HWM_PWM_2_LABEL=""

CONFIG_HWM_PWM_NUM=2
CONFIG_HWM_PWM_MAP={ CONFIG_HWM_PWM_0_ENABLE, CONFIG_HWM_PWM_1_ENABLE }

# ===== GPIO Configuration =====
```
